## kernel/motorola/java/drivers/net/wireless/sprd/Kconfig
```kconfig
menuconfig SPRD_WLAN
	bool "Spreadtrum WLAN/BT drivers"
	default y
	---help---
	Unisoc (Spreadtrum) WLAN/BT drivers for SPRD/Motorola platforms.

if SPRD_WLAN
source "drivers/net/wireless/sprd/sprdwl_ng/Kconfig"
source "drivers/net/wireless/sprd/sprdbt_tty/Kconfig"
endif
```

## kernel/motorola/java/drivers/net/wireless/sprd/sprdbt_tty/Kconfig
```kconfig
config SPRDBT_TTY
	tristate "Unisoc sprdbt_tty Bluetooth controller transport"
	depends on SPRD_WLAN
	default y
	---help---
	Reconstructed Unisoc BT HCI transport (tty over the WCN bus,
	LPM, rfkill, crash dump). Hardware-validated 2026-09-26.
	Exports wcn_reset_notifier_list — do not hot-unload while other
	WCN modules reference it.
```

## kernel/motorola/java/drivers/net/wireless/sprd/sprdwl_ng/Kconfig
```kconfig
config SPRDWL_NG
	tristate "Spreadtrum sprdwl_ng WLAN driver (sc2355, SDIO)"
	depends on CFG80211
	default y
	---help---
	Reconstructed Unisoc sc2355 WLAN driver for the Motorola Moto G20
	(java / sharkl5pro). Hardware-validated 2026-09-26: association,
	DHCP, traffic, scans equivalent to the stock module. Built as a
	module (m) so the Android WiFi HAL keeps its finit_module /
	delete_module lifecycle; do not build in (=y) without reworking the
	HAL power sequencing.
```
